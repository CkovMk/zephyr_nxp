## drivers/gpio/Kconfig.pca_series
```kconfig
# PCA_SERIES GPIO configuration options

# Copyright 2024 NXP
# SPDX-License-Identifier: Apache-2.0

menuconfig GPIO_PCA_SERIES
	bool "PCA_SERIES I2C-based GPIO chip"
	default y
	depends on DT_HAS_NXP_PCA9538_ENABLED || DT_HAS_NXP_PCA9539_ENABLED || \
			DT_HAS_NXP_PCA9554_ENABLED || DT_HAS_NXP_PCA9555_ENABLED || \
			DT_HAS_NXP_PCA6408_ENABLED || DT_HAS_NXP_PCA6416_ENABLED || \
			DT_HAS_NXP_PCAL9538_ENABLED || DT_HAS_NXP_PCAL9539_ENABLED || \
			DT_HAS_NXP_PCAL6408_ENABLED || DT_HAS_NXP_PCAL6416_ENABLED || \
			DT_HAS_NXP_PCAL6524_ENABLED || DT_HAS_NXP_PCAL6534_ENABLED
	select I2C
	help
	  Enable driver for PCA_SERIES I2C-based GPIO chip.

config GPIO_PCA_SERIES_INIT_PRIORITY
	int "Init priority"
	default 70
	depends on GPIO_PCA_SERIES
	help
	  Device driver initialization priority.

config GPIO_PCA_SERIES_INTERRUPT
	bool "Interrupt enable"
	default y
	depends on GPIO_PCA_SERIES
	help
	  Enable interrupt support in PCA_SERIES driver.
	  Note that some devices this driver supports cannot reliably detect
	  short-pulse interrupts due to its design.

config GPIO_PCA_SERIES_CACHE_ALL
	bool "Cache all registers"
	default y
	depends on GPIO_PCA_SERIES
	help
	  Cache all registers in RAM for faster configuration.
	  When disabled, only output registers will be cached.
	  On devices w/o interrupt status, it will also cache input state to
	  detect changes of pins status.

config GPIO_PCA_SERIES_HAS_EXTENDED_DEVICE
	bool "Extended device is enabled in Devicetree"
	default y
	depends on DT_HAS_NXP_PCAL6524_ENABLED || DT_HAS_NXP_PCAL6534_ENABLED
	help
	  Enable support for extended devices with interrupt edge and clear
	  capabilities. If no such devices is present, this option is
	  automatically disabled to reduce code size. You may also disable
	  this option manually to enforce legacy interrupt handling.
```
