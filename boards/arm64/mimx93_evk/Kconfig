## boards/arm64/mimx93_evk/Kconfig
```kconfig
choice BOARD_MIMX93_EVK_A55_EXP_SEL
	prompt  "i.MX93 EVK board mux control"
	default BOARD_MIMX93_EVK_A55_EXP_SEL_NO_INIT
	#depends on I2C

config BOARD_MIMX93_EVK_A55_EXP_SEL_NO_INIT
	bool "Do not control board mux during boot"
	help
	  Do not control EXP_SEL signal to select group on GPIO muxes on
	  i.MX 93 EVK.

config BOARD_MIMX93_EVK_A55_EXP_SEL_MUX_A
	bool "Select board mux group A"
	help
	  Control EXP_SEL signal to select group A on all GPIO muxes on
	  i.MX 93 EVK. Requires I2C2 and ADP5580_GPIO driver.

config BOARD_MIMX93_EVK_A55_EXP_SEL_MUX_B
	bool "Select board mux group B"
	help
	  Control EXP_SEL signal to select group B on all GPIO muxes on
	  i.MX 93 EVK. Requires I2C2 and ADP5580_GPIO driver.

endchoice

config BOARD_MIMX93_EVK_A55_EXP_SEL_INIT_PRIO
	int "i.MX 93 EVK board mux control init priority"
	default 50
	depends on BOARD_MIMX93_EVK_A55_EXP_SEL_MUX_A || BOARD_MIMX93_EVK_A55_EXP_SEL_MUX_B

choice BOARD_MIMX93_EVK_A55_LOG_LEVEL
    prompt "i.MX 93 EVK board init log level"
    default BOARD_MIMX93_EVK_A55_LOG_LEVEL_INFO
    help
      Control log level for i.MX 93 EVK board init.

    config BOARD_MIMX93_EVK_A55_LOG_LEVEL_NONE
        bool "No logs"
    config BOARD_MIMX93_EVK_A55_LOG_LEVEL_ERROR
        bool "Error logs"
    config BOARD_MIMX93_EVK_A55_LOG_LEVEL_WARNING
        bool "Warning logs"
    config BOARD_MIMX93_EVK_A55_LOG_LEVEL_INFO
        bool "Info logs"
    config BOARD_MIMX93_EVK_A55_LOG_LEVEL_DEBUG
        bool "Debug logs"
endchoice #BOARD_MIMX93_EVK_A55_LOG_LEVEL

config BOARD_MIMX93_EVK_A55_LOG_LEVEL
    int
    default 0 if BOARD_MIMX93_EVK_A55_LOG_LEVEL_DEBUG
    default 1 if BOARD_MIMX93_EVK_A55_LOG_LEVEL_INFO
    default 2 if BOARD_MIMX93_EVK_A55_LOG_LEVEL_WARNING
    default 3 if BOARD_MIMX93_EVK_A55_LOG_LEVEL_ERROR
    default 4 if BOARD_MIMX93_EVK_A55_LOG_LEVEL_NONE
```

## drivers/i2c/Kconfig.mcux_flexio
```kconfig
# Copyright (c) 2023, STRIM, ALC
# SPDX-License-Identifier: Apache-2.0

config I2C_MCUX_FLEXIO
	bool "MCUX FlexIO I2C driver"
	depends on HAS_MCUX_FLEXIO
	depends on CLOCK_CONTROL
	select MCUX_FLEXIO
	help
	  Enable support for MCUX FlexIO I2C driver.
```

## drivers/regulator/Kconfig.fixed_seq
```kconfig
# Copyright 2023 NXP
# SPDX-License-Identifier: Apache-2.0

config REGULATOR_FIXED_SEQ
	bool "Multiple-GPIO-controlled regulators with power sequence"
	default y
	depends on DT_HAS_REGULATOR_FIXED_SEQ_ENABLED
	depends on GPIO
	help
	  Enable the driver for GPIO-controlled regulators

if REGULATOR_FIXED_SEQ

config REGULATOR_FIXED_SEQ_INIT_PRIORITY
	int "Init priority"
	default 75
	help
	  Device driver initialization priority

endif # REGULATOR_FIXED_SEQ
```

## dts/bindings/i2c/nxp,imx-flexio-i2c-master.yaml
```yaml
# Copyright (c) 2023, STRIM, ALC
# SPDX-License-Identifier: Apache-2.0

description: NXP i.MX FlexIO I2C controller

compatible: "nxp,imx-flexio-i2c-master"

include: [i2c-controller.yaml, imx-flexio-common.yaml]

properties:
  sda-pin:
    type: int
    required: true
    description: |
      Pin select for data.
  scl-pin:
    type: int
    required: true
    description: |
      Pin select for clock.

child-binding:
  description: NXP FlexIO port

  include: i2c-device.yaml
```

## dts/bindings/misc/imx-flexio-common.yaml
```yaml
# Copyright (c) 2023, STRIM, ALC
# SPDX-License-Identifier: Apache-2.0

description: NXP i.MX FlexIO controller

include: [pinctrl-device.yaml]

properties:
  shifters:
    type: array
    required: true
    description: |
      Shifter index used in FlexIO interface.
  timers:
    type: array
    required: true
    description: |
      Timer index used in FlexIO interface.
```

## dts/bindings/regulator/regulator-fixed-seq.yaml
```yaml
# Copyright 2019-2020 Peter Bigot Consulting, LLC
# SPDX-License-Identifier: Apache-2.0

description: GPIO-controlled regulators with power sequence

include:
  - name: base.yaml
  - name: regulator.yaml
    property-allowlist:
      - regulator-name
      - regulator-boot-on
      - regulator-always-on

compatible: "regulator-fixed-seq"

properties:
  regulator-name:
    required: true

  enable-gpios:
    type: phandle-array
    required: true
    description: |
      GPIO to use to enable/disable the regulator.

      Unlike the gpio property in the Linux bindings this array must
      provide the GPIO polarity and open-drain status in the phandle
      selector.  The Linux enable-active-high and gpio-open-drain
      properties are not valid for Zephyr devicetree files.

  enable-gpio-names:
    type: string-array
    description: |
      Name for enable-gpios.

  enable-seq:
    type: array
    required: true
    description: |
      Power on sequence.

      The number indicates the index of GPIO in enable-gpios array.

  enable-delay:
    type: array
    required: true
    description: |
      Power on delay in microseconds for corresponding sequence.

      The number indicates delay in microseconds after setting the gpio.

  disable-seq:
    type: array
    required: true
    description: |
      Power off sequence.

      See description for enable-seq.

  disable-delay:
    type: array
    required: true
    description: |
      Power off delay in microseconds.

      See description for enable-delay.
```

## dts/bindings/video/aptina,mt9m114.yaml
```yaml
# Copyright (c) 2019, Linaro Limited
# SPDX-License-Identifier: Apache-2.0

description: MT9M114 CMOS video sensor

compatible: "aptina,mt9m114"

include: [i2c-device.yaml, pinctrl-device.yaml]

properties:
  ctrl-dovdd-gpios:
    type: phandle-array
    required: true
    description:
      DOVDD control gpio. Driver will initialize this GPIO to active high

  ctrl-avdd-gpios:
    type: phandle-array
    required: true
    description:
      AVDD control gpio. Driver will initialize this GPIO to active high

  ctrl-dvdd-gpios:
    type: phandle-array
    required: true
    description:
      DVDD control gpio. Driver will initialize this GPIO to active high

  ctrl-extclk-gpios:
    type: phandle-array
    required: true
    description:
      EXTCLK control gpio. Driver will initialize this GPIO to active high

  ctrl-9509-gpios:
    type: phandle-array
    required: true
    description:
      PCA9509 control gpio. Driver will initialize this GPIO to active high

  ctrl-4t245-gpios:
    type: phandle-array
    required: true
    description:
      74AVC4T245PW control gpio. Driver will initialize this GPIO to active low

  ctrl-16t245-gpios:
    type: phandle-array
    required: true
    description:
      74AVC16T245DGG control gpio. Driver will initialize this GPIO to active low

  regulator:
    type: phandles
    required: true

  powerdown-gpios:
    type: phandle-array
    required: true
    description:
      power down gpio. Driver will initialize this GPIO to active high

  reset-gpios:
    type: phandle-array
    required: true
    description:
      reset gpio. Driver will initialize this GPIO to active low
```
